#include <stdint.h>
#include <stdlib.h>
#include "freertos/FreeRTOS.h"
#include "freertos/task.h"
#include "driver/i2s_std.h"
#include "driver/gpio.h"
#include "esp_check.h"
#include "filesystem/sd_card.h"
#include "configuration.h"
#include <math.h>
#include <string.h>
#include "esp_heap_caps.h"

#define EXAMPLE_I2S_DUPLEX_MODE     CONFIG_USE_DUPLEX
#define EXAMPLE_STD_BCLK_IO1        EXAMPLE_I2S_BCLK_IO1      // I2S bit clock io number
#define EXAMPLE_STD_WS_IO1          EXAMPLE_I2S_WS_IO1      // I2S word select io number
#define EXAMPLE_STD_DOUT_IO1        EXAMPLE_I2S_DOUT_IO1     // I2S data out io number
#define EXAMPLE_STD_DIN_IO1         EXAMPLE_I2S_DIN_IO1     // I2S data in io number

#define EXAMPLE_BUFF_SIZE               16000

static i2s_chan_handle_t                tx_chan;        // I2S tx channel handler
static i2s_chan_handle_t                rx_chan;        // I2S rx channel handler

#define SAMPLE_RATE 44100
#define SAMPLE_COUNT 440

const char *TAG = "pcm";

typedef struct {
    char riff_header[4];
    uint32_t wav_size;
    char wave_header[4];
    char fmt_header[4];
    uint32_t fmt_chunk_size;
    uint16_t audio_format;
    uint16_t num_channels;
    uint32_t sample_rate;
    uint32_t byte_rate;
    uint16_t sample_alignment;
    uint16_t bit_depth;
    char data_header[4];
    uint32_t data_bytes;
} wav_header_t;

static void i2s_example_write_task(void *args) {
    const char *file_name = "/sdcard/general/correct.wav";
    
    FILE *f = fopen(file_name, "rb");
    if (!f) {
        ESP_LOGE(TAG, "Failed to open file for reading");
        vTaskDelete(NULL);
        return;
    }

    // Read and parse the WAV header
    wav_header_t wav_header;
    fread(&wav_header, sizeof(wav_header), 1, f);


    size_t free_heap = esp_get_free_heap_size();
    printf("Free heap size: %d bytes\n", free_heap);
    size_t buffer_size = EXAMPLE_BUFF_SIZE;
    uint8_t *buffer = (uint8_t *)malloc(buffer_size);

    free_heap = esp_get_free_heap_size();
    printf("Free heap size: %d bytes\n", free_heap);
    // Enable the TX channel
    ESP_ERROR_CHECK(i2s_channel_enable(tx_chan));
    size_t bytes_read;
    while ((bytes_read = fread(buffer, 1, buffer_size, f)) > 0) {
        size_t bytes_written;
        ESP_ERROR_CHECK(i2s_channel_write(tx_chan, buffer, bytes_read, &bytes_written, portMAX_DELAY));
        if (bytes_written < bytes_read) {
            fseek(f, bytes_written - bytes_read, SEEK_CUR);
        }
    }

    free(buffer);
    fclose(f);
    vTaskDelete(NULL);
}

static void i2s_example_init_std_duplex(void)
{
    /* Setp 1: Determine the I2S channel configuration and allocate both channels
     * The default configuration can be generated by the helper macro,
     * it only requires the I2S controller id and I2S role */
    i2s_chan_config_t chan_cfg = I2S_CHANNEL_DEFAULT_CONFIG(I2S_NUM_AUTO, I2S_ROLE_MASTER);
    ESP_ERROR_CHECK(i2s_new_channel(&chan_cfg, &tx_chan, &rx_chan));

    /* Step 2: Setting the configurations of standard mode, and initialize rx & tx channels
     * The slot configuration and clock configuration can be generated by the macros
     * These two helper macros is defined in 'i2s_std.h' which can only be used in STD mode.
     * They can help to specify the slot and clock configurations for initialization or re-configuring */
    i2s_std_config_t std_cfg = {
        .clk_cfg  = I2S_STD_CLK_DEFAULT_CONFIG(16000),
        .slot_cfg = I2S_STD_MSB_SLOT_DEFAULT_CONFIG(I2S_DATA_BIT_WIDTH_32BIT, I2S_SLOT_MODE_STEREO),
        .gpio_cfg = {
            .mclk = I2S_GPIO_UNUSED,    // some codecs may require mclk signal, this example doesn't need it
            .bclk = LINE_BCK_PIN,
            .ws   = LINE_LCK_PIN,
            .dout = LINE_DIN_PIN,
            .din  = LINE_DIN_PIN, // In duplex mode, bind output and input to a same gpio can loopback internally
            .invert_flags = {
                .mclk_inv = false,
                .bclk_inv = false,
                .ws_inv   = false,
            },
        },
    };
    /* Initialize the channels */
    ESP_ERROR_CHECK(i2s_channel_init_std_mode(tx_chan, &std_cfg));
    ESP_ERROR_CHECK(i2s_channel_init_std_mode(rx_chan, &std_cfg));
}

void setup_pcm_audio(const char *file_name) {
    i2s_example_init_std_duplex();
    xTaskCreate(i2s_example_write_task, "i2s_example_write_task", 8192, (void *)file_name, 4, NULL);
}